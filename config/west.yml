## config/west.yml
```yaml
manifest:
  remotes:
    - name: slicemk
      url-base: https://github.com/slicemk
  projects:
    - name: zmk
      remote: slicemk
      revision: d9a4a5e23c18309283716b0e3ad5cad13628aba2 # main
      import: app/west.yml
  self:
    path: config
```
